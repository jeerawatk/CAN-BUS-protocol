#include <U8glib.h>
#include <defaults.h>
#include <global.h>
#include <mcp2515.h>
#include <mcp2515_defs.h>
#include <Canbus.h>
char UserInput;
int data;
char buffer[256];  //Data will be temporarily stored to this buffer before being written to the file
char *EngineRPM;
//char rpm[256];
//char speeds[20];

unsigned int rpm1=0,rpm2=0,rpm3=0;
unsigned int speedA=0,speedB=0;
unsigned int speeds=0;
unsigned int temp1=0;
unsigned int RPM=0;
 
U8GLIB_SSD1306_128X64 u8g(U8G_I2C_OPT_NO_ACK);
 
const int buttonPin = 3;     // the number of the pushbutton pin
int buttonState = 0;         // variable for reading the pushbutton status
int mode = 1;
int lockdoor = 1;

const uint8_t logo[] PROGMEM =
{ 
0x0, 0x0, 0x0, 0x0, 0x0, 0x0, 0x0, 0x0, 0x0, 0x0, 0x0, 0x0, 0x0, 0x0, 0x0, 
0x0, 0x0, 0x0, 0x0, 0x0, 0x0, 0x0, 0x0, 0x0, 0x0, 0x0, 0x0, 0x0, 0x0, 0x0, 
0x0, 0x0, 0x0, 0x0, 0x0, 0x0, 0x0, 0x0, 0x0, 0x0, 0x0, 0x0, 0x0, 0x0, 0x0, 
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0x0, 0x0, 0x0, 0x0, 
 };

const uint8_t water[] PROGMEM =
{ 
0x0, 0x0, 0x0, 0x0, 0x0, 0x0, 0x0, 0x0, 0x0, 0x0, 0x0, 0x0, 0x0, 0x0, 0x0, 
0x0, 0x0, 0x0, 0x0, 0x0, 0x0, 0x0, 0x0, 0x0, 0x0, 0x0, 0x0, 0x0, 0x0, 0x0, 
0x0, 0x0, 0x0, 0x0, 0x0, 0x0, 0x0, 0x0, 0x0, 0x0, 0x0, 0x0, 0x0, 0x0, 0x0, 
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0x0, 0x0, 0x0, 0x0, 
 };

const uint8_t oil[] PROGMEM =
 { 
0x0, 0x0, 0x0, 0x0, 0x0, 0x0, 0x0, 0x0, 0x0, 0x0, 0x0, 0x0, 0x0, 0x0, 0x0, 
0x0, 0x0, 0x0, 0x0, 0x0, 0x0, 0x0, 0x0, 0x0, 0x0, 0x0, 0x0, 0x0, 0x0, 0x0, 
0x0, 0x0, 0x0, 0x0, 0x0, 0x0, 0x0, 0x0, 0x0, 0x0, 0x0, 0x0, 0x0, 0x0, 0x0, 
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0x0, 0x0, 0x0, 0x0, 
 };
 
void setup()
{
  u8g.firstPage();
Serial.begin(9600);
Serial.println("CAN-Bus Demo");

if(Canbus.init(CANSPEED_500))  /* Initialise MCP2515 CAN controller at the specified speed */
  {
    Serial.println("CAN Init ok");
  } else
  {
    Serial.println("Can't init CAN");
  } 
  do
  {
    intro();
  }
  while (u8g.nextPage());
  delay(3000);
}
 
 
void loop(void) 
{
  buttonState = digitalRead(buttonPin);

  // picture loop
  //if (buttonState == HIGH) {
  //  mode=mode+1;
  //  delay(100);
 // }
  
  u8g.firstPage();  
  do {
    if(mode==1){
      engineRPM();
      mode1();
    }
    else if(mode==2){
      mode2();
    }
    else if(mode==3){
      mode3();
    }
    else if(mode==4){
      mode = 1;
    }
  } while( u8g.nextPage() );
}
 
void intro(void) {
  u8g.drawBitmapP(0, 0, 16, 64, logo);
  //u8g.setFont(u8g_font_04b_03r);
  //u8g.drawStr( 15, 30, "www.ioinnovationlab.com");
  //u8g.drawStr( 15, 40, "version 1.0");  
}

void engineRPM(void){
  tCAN message;
if (mcp2515_check_message()) 
  {
    if (mcp2515_get_message(&message)) 
  {
        if(message.id == 0x158 )  //uncomment when you want to filter
             {
              //speeds = ((((message.data[4]*256)+message.data[5])*0.62137119)/100)*1.609344;
              speedA=message.data[4];
              speedB=message.data[5];
              speeds = ((((speedA*256)+speedB)*0.62137119)/100)*1.609344;
              RPM = (message.data[2]*256)+message.data[3];
     
  }
       // else if(message.id == 0x1DC )  //uncomment when you want to filter
       //      {
       //       RPM = ((message.data[1]*256)+message.data[2])+message.data[3];
  //}
         else if(message.id == 0x188){
             if(speeds >= 20 && message.data[3] == 0x08 && lockdoor == 1){
                lockdoor=0; // lock
             }
             else if(message.data[3] == 0x01 && lockdoor == 0){
                lockdoor=0;
             }
         }
           }}
}


void mode1(void) {
  
  // graphic commands to redraw the complete screen should be placed here  
  u8g.setFont(u8g_font_7x13B);
  u8g.setPrintPos(0, 10); 
  u8g.print("SPEED");  
  u8g.setPrintPos(0, 25); 
  u8g.print("km/h"); 
  u8g.setPrintPos(0, 45); 
  u8g.print("RPM");
  u8g.setPrintPos(0, 60); 
  u8g.print("r/min");
  u8g.setPrintPos(100, 10);
  //u8g.print(lockdoor);
  u8g.setPrintPos(100, 26);
  //u8g.print("volt");


  u8g.setFont(u8g_font_fub25); // 11,14,17,20
  u8g.setPrintPos(40, 26); 
  u8g.print(speeds);

  u8g.setPrintPos(40, 60);
  //u8g.print(((rpm1*65536)+(rpm2*256)+rpm3)/500);
  //u8g.print(((rpm1*256)+rpm2)+rpm3);
  u8g.print(RPM);
  



}

void mode2(void) {
  // graphic commands to redraw the complete screen should be placed here  
  u8g.drawBitmapP(0, 0, 16, 64, water);
  u8g.setFont(u8g_font_7x13B);
  u8g.setPrintPos(50, 20); 
  u8g.print("Water Temp");
  u8g.setFont(u8g_font_fub25); // 11,14,17,20
  u8g.setPrintPos(48, 52); 
  u8g.print("000");
}
void mode3(void) {
  // graphic commands to redraw the complete screen should be placed here  
  u8g.drawBitmapP(0, 0, 16, 64, oil);
  u8g.setFont(u8g_font_7x13B);
  u8g.setPrintPos(50, 20); 
  u8g.print("Fuel (%)");
  u8g.setFont(u8g_font_fub25); // 11,14,17,20
  u8g.setPrintPos(48, 52); 
  u8g.print("100"); 
}
